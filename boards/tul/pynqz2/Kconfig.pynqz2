## boards/tul/pynqz2/Kconfig.pynqz2
```kconfig
# Digilent Zybo board configuration

# Copyright (c) 2022 Henrik Brix Andersen <henrik@brixandersen.dk>
# SPDX-License-Identifier: Apache-2.0

config BOARD_PYNQZ2
	select SOC_XILINX_XC7Z020
```

## boards/tul/pynqz2/pynqz2_defconfig
```kconfig
# SPDX-License-Identifier: Apache-2.0

# The GTC is always clocked at 1/2 of the CPU frequency (CPU_3x2x)
CONFIG_ARM_ARCH_TIMER=y
CONFIG_SYS_CLOCK_HW_CYCLES_PER_SEC=325000000

CONFIG_PINCTRL=y
CONFIG_SERIAL=y
CONFIG_CONSOLE=y
CONFIG_UART_CONSOLE=y

CONFIG_UART_NS16550=y
#FIXME: figure out why mmu initial failed.
CONFIG_ARM_AARCH32_MMU=n # add this to avoid FSBL init failure
```
